## arm_emultator_2.6/defconfig
```kconfig
BR2_arm=y
BR2_KERNEL_HEADERS_3_2=y
BR2_TOOLCHAIN_BUILDROOT_INET_RPC=y
BR2_PTHREAD_DEBUG=y
BR2_LINUX_KERNEL=y
BR2_LINUX_KERNEL_CUSTOM_LOCAL=y
BR2_LINUX_KERNEL_CUSTOM_LOCAL_PATH="~/arm_emulator"
BR2_LINUX_KERNEL_DEFCONFIG="versatile"
```
